#include "headfile.h"
 uint16 number_j = 0;
 uint16 num;
void time_init(void)
{
	TMOD=0x01;		  //设置定时器0的工作方式为工作方式1
	TH0=(65525-50000)/256;	//赋初值，定时50ms
	TL0=(65525-50000)%256;
	EA=1;	   //开总中断
	ET0=1;	   //开定时器0中断
	TR0=1;	   //启动定时器0
}
/***************************************************************
* 函数名称：timer
* 功能说明：计时器
* 参数说明：
* 函数返回：
* 修改时间：2022年12月19日
* 备 注：
***************************************************************/
void timer() interrupt 1
{
	TH0=(65525-50000)/256;	//赋初值，定时50ms
	TL0=(65525-50000)%256;
	num++;
				if(num==2)  //0.1s时间到
				{
					number_j++;   //清零
					num = 0;
				}
}
/***************************************************************
* 函数名称：Key()
* 功能说明：按键函数
* 参数说明：
* 函数返回：
* 修改时间：2022年12月19日
* 备 注：
***************************************************************/
short Key()
{
	uint16 number = 0;
	if(K2 == 0) number = 2;
	if(K3 == 0) number = 3;
	if(K4 == 0) number = 4;
	if(K5 == 0) number = 5;
	switch(number)
	{
		case 2:
			Delay1ms(225);
			return 2;
			break;
		case 3:
			Delay1ms(225);
			return 3;
			break;			
		case 4:
			Delay1ms(225);
			return 4;
			break;			
		case 5:
			Delay1ms(225);
			return 5;
			break;			
	}
}